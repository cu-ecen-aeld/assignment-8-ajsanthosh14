## base_external/package/char-device-driver/Config.in
```kconfig
config BR2_PACKAGE_CHAR_DEVICE_DRIVER
	bool "char-device-driver"
	help
	  Includes character device driver, which will be loaded to the rfs of the image.
```

## base_external/package/ldd/Config.in
```kconfig
config BR2_PACKAGE_LDD
	bool "lld"
	help
	  Includes the misc-modules and scull components to our target rfs.
	  Used to exercise the load and unload scull drivers and some example drivers from misc-modules
```
